## arch/arm64/configs/neo_defconfig
```kconfig
include lineageos_h990_defconfig
#neocore config
CONFIG_LOCALVERSION=".NeOcOrE"
CONFIG_BOEFFLA_WL_BLOCKER=y
CONFIG_FB_MSM_MDSS_KCAL_CTRL=y
CONFIG_STATE_NOTIFIER=y
CONFIG_LAZYPLUG=y
```
